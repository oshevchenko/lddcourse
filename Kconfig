## Kconfig
```kconfig
menuconfig TKTEST
	tristate "Tktest  support"
#	depends on HAS_IOMEM
	---help---
	  Tktest is useful to connect slow 1-pin devices
	  such as iButtons and thermal sensors.

	  If you want Tktest support, you should say Y here.

	  This Tktest support can also be built as a module.  If so, the module
	  will be called wire.

if TKTEST

config TKTEST_CON
	#depends on CONNECTOR
	bool "Tktest modules test"
	default y
	---help---
	  This allows to communicate with userspace using connector. For more
	  information see <file:Documentation/connector/connector.txt>.
	  There are three types of messages between w1 core and userspace:
	  1. Events. They are generated each time new master or slave device found
		either due to automatic or requested search.
	  2. Userspace commands. Includes read/write and search/alarm search commands.
	  3. Replies to userspace commands.

#source drivers/tktest/Kconfig
#source drivers/w1/slaves/Kconfig

endif # TKTEST
```

## task1/150Router/branch_hornet_linux/ap121/linux/kernels/mips-linux-2.6.31/drivers/misc-modules/Kconfig
```kconfig
#
# Misc-modules configuration
#

menuconfig MISC_MODULES
	tristate "Misc-Modules LDD3 support"
	help
	  Examples from book LDD3

if MISC_MODULES

config COMPLETE
	tristate "Complete module"
	help
	  the writers awake the readers

config FAULTY
	tristate "Faulty module"
	help
	  Generates oops when read

config HELLO
	tristate "Hello module"
    help
      Show hello

config HELLOP
	tristate "Hellop module"

config JIQ
	tristate "Jiq module"

config JIT
	tristate "Jit module"

config KDATAALIGN
	tristate "KDataAlign module"

config KDATASIZE
	tristate "KDataSize module"

config SEQ
	tristate "Seq module"

config SILLY
	tristate "Silly module"

config SLEEP
	tristate "Sleep module"

endif
```

## task1/Kconfig
```kconfig
menuconfig MISCMODULE
    bool "User defined Misc module support"
    ---help---
      User defined Misc module support 
      Say Y here to get to see options for misc modules.
      This option alone does not add any kernel code.

      If you say N, all options in this submenu will be skipped and disabled.

      If unsure, say N.

if MISCMODULE
config MISC_MOD_HELLO
    tristate "Hello world misc module"
    ---help---
      Print hello in syslog when loaded
          Y - kernel build
          M - build to loadable module
      If unsure, say N.

endif # MISCMODULE
```

## task1/kernels/mips-linux-2.6.31/drivers/misc-modules/Kconfig
```kconfig
#
# Misc modules
#

menuconfig MISC_MODULES
	bool "Misc modules"
	default y
	---help---
	  Say Y here to get to see options for misc modules.
	  If you say N, all options in this submenu will be skipped and disabled.

if MISC_MODULES

config MISC_COMPLETE
	bool "Misc-modules complete"
	default y
	help
	  Misc-modules complete

config MISC_FAULTY
	bool "Misc-modules faulty"
	default y
	help
	  Misc-modules faulty
	  
config MISC_HELLO
	bool "Misc-modules hello"
	default y
	help
	  Misc-modules hello
	  
config MISC_HELLOP
	bool "Misc-modules hellop"
	default y
	help
	  Misc-modules hellop
	  
config MISC_JIQ
	bool "Misc-modules jiq"
	default y
	help
	  Misc-modules jiq
	  
config MISC_JIT
	bool "Misc-modules jit"
	default y
	help
	  Misc-modules jit
	  
config MISC_KDATAALIGN
	bool "Misc-modules kdataalign"
	default y
	help
	  Misc-modules kdataalign
	  
config MISC_KDATASIZE
	bool "Misc-modules kdatasize"
	default y
	help
	  Misc-modules kdatasize
	  
config MISC_SEQ
	bool "Misc-modules seq"
	default y
	help
	  Misc-modules seq
	  
config MISC_SILLY
	bool "Misc-modules silly"
	default y
	help
	  Misc-modules silly
	  
config MISC_SLEEPY
	bool "Misc-modules sleepy"
	default y
	help
	  Misc-modules sleepy
	  
endif # MISC_MODULES
```
